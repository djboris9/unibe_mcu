## CMakeLists.txt
```
cmake_minimum_required(VERSION 3.20.0)
set(BOARD nucleo_f446re)

find_package(Zephyr)
include(${ZEPHYR_BASE}/cmake/cfb.cmake NO_POLICY_SCOPE) # CFB custom font dependency
project(tack)

target_sources(app PRIVATE src/c12832a1z_display.c src/magneto.c src/gps.c src/main.c)

# CFB custom font dependencies
set(gen_dir ${ZEPHYR_BINARY_DIR}/include/generated/)
generate_cfb_font_for_target(app fonts/Ac437_IBM_CGAthin.ttf ${gen_dir}/cfb_font_gcathin.h 7 8 -s 8)
```

## prj.conf
```kconfig
# Logging
CONFIG_LOG=y
CONFIG_LOG_DEFAULT_LEVEL=3

# Peripheries
CONFIG_SPI=y
CONFIG_I2C=y
CONFIG_DMA=y
CONFIG_UART_ASYNC_API=y

# Display configs
CONFIG_DISPLAY=y
CONFIG_CHARACTER_FRAMEBUFFER=y
CONFIG_CHARACTER_FRAMEBUFFER_USE_DEFAULT_FONTS=n

# System configs
CONFIG_MAIN_STACK_SIZE=1024
CONFIG_HEAP_MEM_POOL_SIZE=2045

# scanf/printf floating point support
CONFIG_PICOLIBC_IO_FLOAT=y

# Enable thread analyzer
CONFIG_THREAD_ANALYZER=y
CONFIG_THREAD_ANALYZER_AUTO=y
CONFIG_THREAD_ANALYZER_AUTO_INTERVAL=60
CONFIG_THREAD_ANALYZER_USE_LOG=y
CONFIG_LOG_THREAD_ID_PREFIX=y
```

## app.overlay
```dts
/* is nodelabel arduino_spi */
&spi1 {
    status = "okay";
    cs-gpios = <&gpiob 6 GPIO_ACTIVE_HIGH>;
};

&i2c1 {
	clock-frequency = < 0x61a80 >;
    pinctrl-0 = < &i2c1_scl_pb8 &i2c1_sda_pb9 >;
};

/* required for usart3 async API */
&dma1 {
    status = "okay";
};

/*
 * DMA channel 4 has slots for USART3_TX and USART3_RX.
 * Documentation: https://docs.zephyrproject.org/latest/build/dts/api/bindings/dma/st,stm32-dma-v1.html
 */
&usart3 {
    status = "okay";
	pinctrl-0 = < &usart3_tx_pc10 &usart3_rx_pc11 >;
	pinctrl-names = "default";
    dmas = < &dma1 3 4 0x400 0 >,
           < &dma1 1 4 0x480 0 >;
	dma-names = "tx", "rx";
    current-speed = <9600>;
};
```

## src/main.c
```c
#include <zephyr/kernel.h>
#include <zephyr/logging/log.h>
#include <zephyr/display/cfb.h>
#include "c12832a1z_display.h"
#include "cfb_font_gcathin.h"
#include "comm.h"
#include "gps.h"
#include "magneto.h"

LOG_MODULE_REGISTER(unibe_mcu, CONFIG_LOG_DEFAULT_LEVEL);

// FIFO for location services data
K_FIFO_DEFINE(locsvc_fifo);

// Variables for display
struct device *display_dev;
char disp_gps_lat[20];
char disp_gps_lng[20];
char disp_mag[20];

void updateScreen(void) {
	int ret;
	// Clear screen
	ret = cfb_framebuffer_clear(display_dev, false);
	if (ret) {
		LOG_ERR("Error %d: Failed to clear display\n", ret);
		return;
	}

	// Print latitude to screen
	ret = cfb_print(display_dev, disp_gps_lat, 0, 0);
	if (ret) {
		LOG_ERR("Error %d: Failed to print to display\n", ret);
		return;
	}

	// Print longitude to screen
	ret = cfb_print(display_dev, disp_gps_lng, 0, 10);
	if (ret) {
		LOG_ERR("Error %d: Failed to print to display\n", ret);
		return;
	}

	// Print heading to screen
	ret = cfb_print(display_dev, disp_mag, 0, 20);
	if (ret) {
		LOG_ERR("Error %d: Failed to print to display\n", ret);
		return;
	}

	// Finalize
	ret = cfb_framebuffer_finalize(display_dev);
	if (ret) {
		LOG_ERR("Error %d: Failed to finalize CFB\n", ret);
		return;
	}
}

// process_gps_data processes the GPS data and sets the display strings.
// Returns true if the display strings have changed.
static bool process_gps_data(struct locsvc_fifo_t *rx_data) {
	// Filter data that starts with '$GNGGA'
	if (rx_data->data_len >= 6 && strncmp(rx_data->data, "$GNGGA", 6) == 0) {
		LOG_DBG("Received for GPS: '%.*s'\n", rx_data->data_len, (char*)rx_data->data);
		// Example: $GNGGA,114529.000,4656.2592,N,00725.8373,E,2,09,1.23,563.4,M,48.0,M,,*78
		//                 time       lat         lon          Q #s  HDOP  alt   sep  age  ref

		float time, lat, lng;
		char lat_c, lng_c;
		int q, sat;
		int ret = sscanf(rx_data->data, "$GNGGA,%f,%f,%c,%f,%c,%d,%d", &time, &lat, &lat_c, &lng, &lng_c, &q, &sat);
		if (ret != 7) {
			// Set disp_gps value to "unknown"
			snprintf(disp_gps_lat, 20, "unknown lat");
			snprintf(disp_gps_lng, 20, "unknown lng");

			return true;
		}

		// Reformat coordinates and set display string
		// We use only degrees and minutes, no DMS format
		int lat_deg = lat/100;
		lat -= lat_deg*100;
		int lng_deg = lng/100;
		lng -= lng_deg*100;

		snprintf(disp_gps_lat, 20, "%2d %.3f' %c", lat_deg, lat, lat_c);
		snprintf(disp_gps_lng, 20, "%2d %.3f' %c", lng_deg, lng, lng_c);

		return true;
	}

	return false;
}

// process_mag_data processes the magnetometer data and sets the display strings.
// Returns true if the display strings have changed.
static bool process_mag_data(struct locsvc_fifo_t *rx_data) {
	// Read heading as integer from FIFO
	int heading = *(int*)rx_data->data;
	LOG_DBG("Received for magnetometer: %d\n", heading);

	// Set display string
	snprintf(disp_mag, 20, "heading %d deg", heading);

	return true;
}


int main(void) {
	int ret;
	LOG_INF("Hello BME on %s\n", CONFIG_BOARD);

	// Initialize GPS
	gps_init(&locsvc_fifo);

	// Initialize magnetometer
	magneto_init();
	
	// Initialize display
	display_dev = c12832a1z_device(); 
	if (display_dev == NULL) {
		LOG_ERR("%s\n", "Error: Failed to get display device");
		return -1;
	}

	// Initialize CFB
	ret = cfb_framebuffer_init(display_dev);
	if (ret) {
		LOG_ERR("Error %d: Failed to initialize CFB\n", ret);
		return ret;
	}

	// Set font for CFB
	ret = cfb_framebuffer_set_font(display_dev, 0);
	if (ret) {
		LOG_ERR("Error %d: Failed to set font\n", ret);
		return ret;
	}

	// Initial screen
	updateScreen();

	// Start magnetometer
	magneto_start(&locsvc_fifo);

	// Read from locsvc_fifo
	struct locsvc_fifo_t *rx_data;
	while (1) {
		rx_data = k_fifo_get(&locsvc_fifo, K_FOREVER);
		bool changedDisplay = false;

		switch (rx_data->type) {
			case LOCSVC_FIFO_TYPE_MAG:
				changedDisplay |= process_mag_data(rx_data);
				break;
			case LOCSVC_FIFO_TYPE_GPS:
				changedDisplay |= process_gps_data(rx_data);
				break;
			default:
				LOG_ERR("Error: Unknown FIFO type: %d\n", rx_data->type);
				break;
		}

		// Free memory
		k_free(rx_data->data);
		k_free(rx_data);

		// Update screen
		if (changedDisplay) {
			updateScreen();
		}
	}

	return 0;
}
```

## src/c12832a1z_display.c
```c
#include <zephyr/device.h>
#include <zephyr/kernel.h>
#include <zephyr/drivers/display.h>
#include <zephyr/drivers/spi.h>
#include <zephyr/devicetree/spi.h>
#include <zephyr/logging/log.h>
#include <stdlib.h>

LOG_MODULE_DECLARE(unibe_mcu, CONFIG_LOG_DEFAULT_LEVEL);

// Defines
#define LCD_CMD_PAGE_0 0xB0
#define LCD_CMD_COL_0 0x10

// Periphery
static const struct device *const gpioa_dev = DEVICE_DT_GET(DT_NODELABEL(gpioa));
static const struct device *const lcd_dev = DEVICE_DT_GET(DT_NODELABEL(arduino_spi));
static struct spi_cs_control spi_cs_ctrl = SPI_CS_CONTROL_INIT(DT_NODELABEL(arduino_spi), 2);
static struct spi_config spi_cfg;

// Manages A0 pin on display
static void setRegisterMode(bool data) {
	if (data) {
		gpio_pin_set(gpioa_dev, 8, 1);
	} else {
		gpio_pin_set(gpioa_dev, 8, 0);
	}
}

// Manages RST pin on display
static void resetDisplay() {
	gpio_pin_set(gpioa_dev, 6, 0);
	k_msleep(1);
	gpio_pin_set(gpioa_dev, 6, 1);
}

static int sendInstruction(uint8_t inst) {
	setRegisterMode(false); // Set to instruction mode

	// Buffer for instruction
	struct spi_buf txb;
	txb.buf = &inst;
	txb.len = 1U;

	// Buffer set for instruction
	struct spi_buf_set txbufs;
	txbufs.buffers = &txb;
	txbufs.count = 1U;
	
	// Send instruction
	int ret = spi_write(lcd_dev, &spi_cfg, &txbufs);
	if (ret) {
		LOG_ERR("Error %d: Failed to write to SPI device\n", ret);
		return ret;
	}

	return 0;
}

static int c12832a1z_init(void) {
	// Configure GPIOs
	gpio_pin_configure(gpioa_dev, 6, GPIO_OUTPUT_LOW | DT_GPIO_FLAGS(DT_NODELABEL(gpio0), gpios));
	gpio_pin_configure(gpioa_dev, 8, GPIO_OUTPUT_LOW | DT_GPIO_FLAGS(DT_NODELABEL(gpio0), gpios));

	// Configure SPI port for display from devicetree
	spi_cfg.frequency = 1200000; // 1200kHz
	spi_cfg.slave = 0;
	spi_cfg.operation = SPI_OP_MODE_MASTER | SPI_HALF_DUPLEX  | SPI_TRANSFER_MSB | SPI_WORD_SET(8);
	spi_cfg.cs = spi_cs_ctrl;

	// Prepare display
	resetDisplay();
	setRegisterMode(false);

	// Initialize display
	sendInstruction(0xA0); // ADC_NORMAL
	sendInstruction(0xAE); // DISPLAY_OFF
	sendInstruction(0xC8); // COMMON_OUTPUT_MODE_REVERSE
	sendInstruction(0xA2); // BIAS_ONE_NINTH
	sendInstruction(0x2F); // POWER_CONTROL_SET_7
	sendInstruction(0x21); // INTERNAL_RESISTOR_RATIO_1
	sendInstruction(0xAF); // DISPLAY_ON

	return 0;
}

static void c12832a1z_display_get_capabilities(const struct device *dev,
		struct display_capabilities *capabilities)
{
	memset(capabilities, 0, sizeof(struct display_capabilities));
	capabilities->x_resolution = 128;
	capabilities->y_resolution = 64;
	capabilities->supported_pixel_formats = PIXEL_FORMAT_MONO01 | PIXEL_FORMAT_MONO10;
	capabilities->screen_info = SCREEN_INFO_MONO_VTILED | SCREEN_INFO_MONO_MSB_FIRST;
}

static int c12832a1z_display_blanking_off(const struct device *dev)
{
	return 0; // NIY
}

static int c12832a1z_display_blanking_on(const struct device *dev)
{
	return 0; // NIY
}

static int c12832a1z_display_read(const struct device *dev, const uint16_t x,
			      const uint16_t y,
			      const struct display_buffer_descriptor *desc,
			      void *buf)
{
	return -ENOTSUP;
}

static void *c12832a1z_display_get_framebuffer(const struct device *dev)
{
	return NULL;
}

static int c12832a1z_NIY(const struct device *dev, const uint8_t arg)
{
	return -ENOTSUP;
}

static int c12832a1z_display_set_pixel_format(const struct device *dev,
		const enum display_pixel_format pixel_format)
{

	return -ENOTSUP;
}

static int c12832a1z_display_write(const struct device *dev, const uint16_t x,
			       const uint16_t y,
			       const struct display_buffer_descriptor *desc,
			       const void *buf)
{
	// print position but we rerender the whole screen
	LOG_DBG("Writing %dx%d (w,h) @ %dx%d (x,y)\n", desc->width, desc->height, x, y);

	// Invert all pixels
	int tlen = 128*4;
	uint8_t buf2[tlen];
	for (int i = 0; i < tlen; i++) {
		buf2[i] = ((uint8_t*)buf)[tlen-i];
	}

	setRegisterMode(false); // Set to instruction mode

	// Buffer for data
	for (int i = 0; i < 4; i++) {
		sendInstruction(LCD_CMD_PAGE_0 + i); // Switch to page i, inverted
		sendInstruction(LCD_CMD_COL_0); // Column 0

		setRegisterMode(true); // Set to data mode

		// Shift address of buf by whole columns
		struct spi_buf txb;
		txb.buf = buf2 + (i*128);
		txb.len = 128U;

		// Buffer set for data
		struct spi_buf_set txbufs;
		txbufs.buffers = &txb;
		txbufs.count = 1U;

		// Send data
		int ret = spi_write(lcd_dev, &spi_cfg, &txbufs);
		if (ret) {
			LOG_ERR("Error %d: Failed to write to SPI device\n", ret);
		}

		setRegisterMode(false); // Set to instruction mode back
	}

	return 0;
}

static const struct display_driver_api c12832a1z_display_api = {
	.blanking_on = c12832a1z_display_blanking_on,
	.blanking_off = c12832a1z_display_blanking_off,
	.write = c12832a1z_display_write,
	.read = c12832a1z_display_read,
	.get_framebuffer = c12832a1z_display_get_framebuffer,
	.set_brightness = c12832a1z_NIY, //c12832a1z_display_set_brightness,
	.set_contrast = c12832a1z_NIY, //c12832a1z_display_set_contrast,
	.get_capabilities = c12832a1z_display_get_capabilities,
	.set_pixel_format = c12832a1z_display_set_pixel_format,
};


// GetDevice returns the display device for use
// with the character framebuffer
struct device *c12832a1z_device(void) {
	struct device *dev = malloc(sizeof(*dev));
	dev->name = "C12832A1Z";
	dev->api = &c12832a1z_display_api;

	c12832a1z_init();
	
	return dev;
}
```

## src/c12832a1z_display.h
```c
#ifndef C12832A1Z_DISPLAY_H
#define C12832A1Z_DISPLAY_H

struct device *c12832a1z_device(void);

#endif // C12832A1Z_DISPLAY_H
```

## src/comm.h
```c
#ifndef COMM_H
#define COMM_H

enum locsvc_fifo_type {
    LOCSVC_FIFO_TYPE_GPS,
    LOCSVC_FIFO_TYPE_MAG,
};

// FIFO data structure
struct locsvc_fifo_t {
    void *fifo_reserved; /* 1st word reserved for use by FIFO */
    enum locsvc_fifo_type type;
    void *data;
    int data_len;
};

#endif // COMM_H
```

## src/display.c
```c
#include <zephyr/device.h>
#include <zephyr/kernel.h>
#include <zephyr/drivers/display.h>
#include <zephyr/drivers/spi.h>
#include <zephyr/devicetree/spi.h>
#include <zephyr/logging/log.h>
#include <stdlib.h>

LOG_MODULE_DECLARE(unibe_mcu, CONFIG_LOG_DEFAULT_LEVEL);

// Defines
#define LCD_CMD_PAGE_0 0xB0
#define LCD_CMD_COL_0 0x10

// Periphery
static const struct device *const gpioa_dev = DEVICE_DT_GET(DT_NODELABEL(gpioa));
static const struct device *const lcd_dev = DEVICE_DT_GET(DT_NODELABEL(arduino_spi));
static struct spi_cs_control spi_cs_ctrl = SPI_CS_CONTROL_INIT(DT_NODELABEL(arduino_spi), 2);
static struct spi_config spi_cfg;

// Manages A0 pin on display
static void setRegisterMode(bool data) {
	if (data) {
		gpio_pin_set(gpioa_dev, 8, 1);
	} else {
		gpio_pin_set(gpioa_dev, 8, 0);
	}
}

// Manages RST pin on display
static void resetDisplay() {
	gpio_pin_set(gpioa_dev, 6, 0);
	k_msleep(1);
	gpio_pin_set(gpioa_dev, 6, 1);
}

static int sendInstruction(uint8_t inst) {
	setRegisterMode(false); // Set to instruction mode

	// Buffer for instruction
	struct spi_buf txb;
	txb.buf = &inst;
	txb.len = 1U;

	// Buffer set for instruction
	struct spi_buf_set txbufs;
	txbufs.buffers = &txb;
	txbufs.count = 1U;
	
	// Send instruction
	int ret = spi_write(lcd_dev, &spi_cfg, &txbufs);
	if (ret) {
		LOG_ERR("Error %d: Failed to write to SPI device\n", ret);
		return ret;
	}

	return 0;
}

static int c12832a1z_init(void) {
	// Configure GPIOs
	gpio_pin_configure(gpioa_dev, 6, GPIO_OUTPUT_LOW | DT_GPIO_FLAGS(DT_NODELABEL(gpio0), gpios));
	gpio_pin_configure(gpioa_dev, 8, GPIO_OUTPUT_LOW | DT_GPIO_FLAGS(DT_NODELABEL(gpio0), gpios));

	// Configure SPI port for display from devicetree
	spi_cfg.frequency = 400000; // 400kHz
	spi_cfg.slave = 0;
	spi_cfg.operation = SPI_OP_MODE_MASTER | SPI_HALF_DUPLEX  | SPI_TRANSFER_MSB | SPI_WORD_SET(8);
	spi_cfg.cs = spi_cs_ctrl;

	// Prepare display
	resetDisplay();
	setRegisterMode(false);

	// Initialize display
	sendInstruction(0xA0); // ADC_NORMAL
	sendInstruction(0xAE); // DISPLAY_OFF
	sendInstruction(0xC8); // COMMON_OUTPUT_MODE_REVERSE
	sendInstruction(0xA2); // BIAS_ONE_NINTH
	sendInstruction(0x2F); // POWER_CONTROL_SET_7
	sendInstruction(0x21); // INTERNAL_RESISTOR_RATIO_1
	sendInstruction(0xAF); // DISPLAY_ON

	return 0;
}

static void c12832a1z_display_get_capabilities(const struct device *dev,
		struct display_capabilities *capabilities)
{
	const struct c12832a1z_display_config *config = dev->config;
	struct c12832a1z_display_data *disp_data = dev->data;

	memset(capabilities, 0, sizeof(struct display_capabilities));
	capabilities->x_resolution = 128;
	capabilities->y_resolution = 64;
	capabilities->supported_pixel_formats = PIXEL_FORMAT_MONO01 | PIXEL_FORMAT_MONO10;
	capabilities->screen_info = SCREEN_INFO_MONO_VTILED | SCREEN_INFO_MONO_MSB_FIRST;
}

static void NIY(void) {
	LOG_ERR("%s\n", "Not implemented yet");
}

static int c12832a1z_display_blanking_off(const struct device *dev)
{
	return 0; // TODO
}

static int c12832a1z_display_blanking_on(const struct device *dev)
{
	return 0; // TODO
}

static int c12832a1z_display_read(const struct device *dev, const uint16_t x,
			      const uint16_t y,
			      const struct display_buffer_descriptor *desc,
			      void *buf)
{
	return -ENOTSUP;
}

static void *c12832a1z_display_get_framebuffer(const struct device *dev)
{
	return NULL;
}

static int c12832a1z_NIY2(const struct device *dev, const uint8_t arg)
{
	return -ENOTSUP;
}

static int c12832a1z_display_set_pixel_format(const struct device *dev,
		const enum display_pixel_format pixel_format)
{

	return -ENOTSUP;
}

static int c12832a1z_display_write(const struct device *dev, const uint16_t x,
			       const uint16_t y,
			       const struct display_buffer_descriptor *desc,
			       const void *buf)
{
	const struct c12832a1z_display_config *config = dev->config;

	// print position but we rerender the whole screen
	printf("Writing %dx%d (w,h) @ %dx%d (x,y)\n", desc->width, desc->height, x, y);

	// Invert all pixels
	int tlen = 128*4;
	uint8_t buf2[tlen];
	for (int i = 0; i < tlen; i++) {
		buf2[i] = ((uint8_t*)buf)[tlen-i];
	}

	// Buffer for data
	for (int i = 0; i < 4; i++) {
		setRegisterMode(false); // Set to instruction mode
		sendInstruction(LCD_CMD_PAGE_0 + i); // Switch to page i, inverted
		sendInstruction(LCD_CMD_COL_0); // Column 0

		setRegisterMode(true); // Set to data mode

		// Shift address of buf by whole columns
		uint8_t data = 0xff;
		struct spi_buf txb;
		txb.buf = buf2 + (i*128);
		//txb.buf = (uint8_t*)buf + (i*128);
		txb.len = 128U;

		// Buffer set for data
		struct spi_buf_set txbufs;
		txbufs.buffers = &txb;
		txbufs.count = 1U;

		// Send data
		int ret = spi_write(lcd_dev, &spi_cfg, &txbufs);
		if (ret) {
			LOG_ERR("Error %d: Failed to write to SPI device\n", ret);
		}
	}

	printf("done\n");

	return 0;
}

static const struct display_driver_api c12832a1z_display_api = {
	.blanking_on = c12832a1z_display_blanking_on,
	.blanking_off = c12832a1z_display_blanking_off,
	.write = c12832a1z_display_write,
	.read = c12832a1z_display_read,
	.get_framebuffer = c12832a1z_display_get_framebuffer,
	.set_brightness = c12832a1z_NIY2, //c12832a1z_display_set_brightness,
	.set_contrast = c12832a1z_NIY2, //c12832a1z_display_set_contrast,
	.get_capabilities = c12832a1z_display_get_capabilities,
	.set_pixel_format = c12832a1z_display_set_pixel_format,
};


// GetDevice returns the display device for use
// with the character framebuffer
struct device *c12832a1z_device(void) {
	struct device *dev = malloc(sizeof(*dev));
	dev->name = "C12832A1Z";
	dev->api = &c12832a1z_display_api;

	c12832a1z_init();
	
	return dev;
}
```

## src/display.h
```c
#ifndef DISPLAY_H
#define DISPLAY_H

struct device *c12832a1z_device(void);

#endif // DISPLAY_H
```

## src/gps.c
```c
#include <zephyr/kernel.h>
#include <zephyr/device.h>
#include <zephyr/devicetree.h>
#include <zephyr/drivers/uart.h>
#include <zephyr/logging/log.h>
#include <string.h>
#include "comm.h"

LOG_MODULE_DECLARE(unibe_mcu, CONFIG_LOG_DEFAULT_LEVEL);

const struct device *const dev_usart = DEVICE_DT_GET(DT_NODELABEL(usart3));

// DMA buffer length
#define BUFLEN 128

// Line scanner buffer length
#define LINEBUFLEN 128
uint8_t linebuf[LINEBUFLEN];
int linebuf_idx = 0;

static void uart_callback(const struct device *dev, struct uart_event *evt, void *user_data) {
    switch (evt->type) {
        case UART_RX_RDY:
            LOG_DBG("UART RX ready. offset=%d len=%d", evt->data.rx.offset, evt->data.rx.len);

            for (int i = 0; i < evt->data.rx.len; i++) {
                // Get current char
                char chr = evt->data.rx.buf[evt->data.rx.offset + i];
                
                // Handle line endings
                if (chr == '\r' || chr == '\n') {
                    linebuf[linebuf_idx] = chr;

                    // Process only non-zero lines
                    if (linebuf_idx > 0) {
                        char* line = k_malloc(linebuf_idx);
                        memcpy(line, linebuf, linebuf_idx);
                        struct locsvc_fifo_t *tx_data = k_malloc(sizeof(struct locsvc_fifo_t));
                        tx_data->type = LOCSVC_FIFO_TYPE_GPS;
                        tx_data->data_len = linebuf_idx;
                        tx_data->data = line;

                        k_fifo_put((struct k_fifo*) user_data, tx_data);
                    }

                    linebuf_idx = 0;
                } else {
                    linebuf[linebuf_idx] = chr;
                    linebuf_idx++;
                }

                if (linebuf_idx >= LINEBUFLEN) {
                    linebuf_idx = 0;
                }
            }
            break;
        case UART_TX_DONE:
            LOG_DBG("UART TX done");
            break;
        case UART_RX_BUF_REQUEST:
            LOG_DBG("UART RX buffer request");
            // Respond to buffer request
            char* buf = k_malloc(BUFLEN);
            int ret = uart_rx_buf_rsp(dev, buf, BUFLEN);
            if (ret) {
                LOG_ERR("Cannot respond to buffer request: %d", ret);
            }
            break;
        case UART_RX_BUF_RELEASED:
            LOG_DBG("UART RX buffer released");
            k_free(evt->data.rx_buf.buf);
            break;
        case UART_RX_STOPPED:
            LOG_ERR("%s", "UART RX stopped");
            break;
        case UART_TX_ABORTED:
            LOG_ERR("%s", "UART TX aborted");
            break;
        default:
            LOG_ERR("%s", "UART unknown event");
            break;
    }
}

int gps_init(struct k_fifo *result_fifo) {
    int ret;

    // Make device ready
    if (!device_is_ready(dev_usart)) {
        LOG_ERR("Device %s is not ready; cannot connect\n", dev_usart->name);
        return -1;
    }

    // Set USART callback
    uart_callback_set(dev_usart, uart_callback, result_fifo);

    // Enable RX
    char* buf = k_malloc(BUFLEN);
    ret = uart_rx_enable(dev_usart, buf, BUFLEN, SYS_FOREVER_US);
    if (ret) {
        LOG_ERR("Cannot enable RX: %d\n", ret);
        return -1;
    }

    return 0;
}
```

## src/gps.h
```c
#ifndef GPS_H
#define GPS_H

void gps_init(struct k_fifo *result_fifo);

#endif // GPS_H
```

## src/magneto.c
```c
#include <zephyr/kernel.h>
#include <zephyr/device.h>
#include <zephyr/devicetree.h>
#include <zephyr/drivers/i2c.h>
#include <zephyr/logging/log.h>
#include <math.h>
#include "comm.h"

LOG_MODULE_DECLARE(unibe_mcu, CONFIG_LOG_DEFAULT_LEVEL);

const struct device *const dev_i2c = DEVICE_DT_GET(DT_NODELABEL(i2c1));

static uint8_t curBank;

// slectBank selects the bank of the ICM-20948
static void selectBank(uint8_t bank) {    
    if (bank == curBank) {
        return;
    }

    int ret = i2c_reg_write_byte(dev_i2c, 0x69, 0x7F, bank<<4);
    if (ret) {
        LOG_ERR("Error %d: Failed to select bank\n", ret);
    }

    curBank = bank;
}

// magneto_read reads the magnetometer data from the AK09916
static int magneto_read(struct k_fifo *result_fifo) {
    int ret;

    // Read magnetometer data
    selectBank(3);

    uint8_t mag_data_reg = 0x11;
    uint8_t mag_data[6] = {0};
    ret = i2c_write_read(dev_i2c, 0x0c, &mag_data_reg, 1, mag_data, 6);
    if (ret) {
        LOG_ERR("Error %d: Failed to read magnetometer data\n", ret);
        return -1;
    }

    // Read ST2 register to end measurement
    mag_data_reg = 0x18;
    uint8_t tmp;
    ret = i2c_write_read(dev_i2c, 0x0c, &mag_data_reg, 1, &tmp, 1);
    if (ret) {
        LOG_ERR("Error %d: Failed to read ST2 register\n", ret);
        return -1;
    }

    // Convert magnetometer data to int16_t
    int16_t mag_x = (mag_data[1] << 8) | mag_data[0];
    int16_t mag_y = (mag_data[3] << 8) | mag_data[2];
    int16_t mag_z = (mag_data[5] << 8) | mag_data[4];

    // Convert magnetometer data to float and scale to uT
    float mag_x_f = (float)mag_x * 0.15f;
    float mag_y_f = (float)mag_y * 0.15f;
    float mag_z_f = (float)mag_z * 0.15f;

    // Send magnetometer data to the result FIFO
    LOG_DBG("magneto: %f %f %f\n", mag_x_f, mag_y_f, mag_z_f);

    // Convert data to compass heading in degrees
    // Reference: https://cdn-shop.adafruit.com/datasheets/AN203_Compass_Heading_Using_Magnetometers.pdf
    float heading;
    if (mag_y_f > 0) {
        heading = 90.0f - atanf(mag_x_f / mag_y_f) * 180.0f / 3.14159265359;
    } else if (mag_y_f < 0) {
        heading = 270.0f - atanf(mag_x_f / mag_y_f) * 180.0f / 3.14159265359;
    } else if (mag_x_f < 0) { // y == 0
        heading = 180.0f;
    } else { // y == 0
        heading = 0.0f;
    }

    LOG_DBG("heading: %f\n", heading);

    // Send heading to the result FIFO
    int *heading_int = k_malloc(sizeof(int));
    *heading_int = (int)heading;

    struct locsvc_fifo_t *tx_data = k_malloc(sizeof(struct locsvc_fifo_t));
    tx_data->type = LOCSVC_FIFO_TYPE_MAG;
    tx_data->data_len = sizeof(int);
    tx_data->data = heading_int;

    k_fifo_put(result_fifo, tx_data);

    return 0;
}

int magneto_init() {
    int ret;

    // Make device ready
    if (!device_is_ready(dev_i2c)) {
        printk("Device %s is not ready; cannot connect\n", dev_i2c->name);
        return -1;
    }
    
    // Read WhoAmI register of the ICM-20948
    selectBank(0);

    uint8_t whoami_reg = 0x00;
    uint8_t whoami_data = 0x00;
    ret = i2c_write_read(dev_i2c, 0x69, &whoami_reg, 1, &whoami_data, 1);
    if (ret) {
        LOG_ERR("Error %d: Failed to read WhoAmI register\n", ret);
        return -1;
    }

    // Check if ICM-20948 is already bypassed, this is just heuristics
    if (whoami_data == 0x00) {
        LOG_INF("%s", "ICM-20948 is already bypassed\n");
    } else {
        // Check if WhoAmI register is correct
        if (whoami_data != 0xEA) {
            LOG_ERR("Error: Incorrect WhoAmI ICM-20948 register value: %d\n", whoami_data);
            return -1;
        }

        // Reset device, this is crucial for the magnetometer to work
        ret = i2c_reg_write_byte(dev_i2c, 0x69, 0x06, 0x80); // PWR_MGMT_1 (DEVICE_RESET = 1)
        if (ret) {
            LOG_ERR("Error %d: Failed to reset ICM-20948\n", ret);
            return -1;
        }

        // Wait for device to reset
        k_msleep(1);

        // Wakeup device and enable I2C bypass so we can directly access the magnetometer
        ret = i2c_reg_write_byte(dev_i2c, 0x69, 0x06, 0x01); // PWR_MGMT_1 (CLKSEL = 1, SLEEP = 0)
        if (ret) {
            LOG_ERR("Error %d: Failed to wake up ICM-20948\n", ret);
            return -1;
        }

        ret = i2c_reg_write_byte(dev_i2c, 0x69, 0x0F, 0x02); // INT_PIN_CFG (BYPASS_EN = 1)
        if (ret) {
            LOG_ERR("Error %d: Failed to enable bypass of ICM-20948\n", ret);
            return -1;
        }
    }

    // Read magnetometer WhoAmI register
    uint8_t mag_whoami_reg = 0x01;
    uint8_t mag_whoami_data = 0x00;
    ret = i2c_write_read(dev_i2c, 0x0c, &mag_whoami_reg, 1, &mag_whoami_data, 1);
    if (ret) {
        LOG_ERR("Error %d: Failed to read magnetometer WhoAmI register\n", ret);
        return -1;
    }

    // Check if magnetometer WhoAmI register is correct
    if (mag_whoami_data != 0x09) {
        LOG_ERR("Error: Incorrect magnetometer WhoAmI register value: %d\n", mag_whoami_data);
        return -1;
    }

    // Set magnetometer to continuous measurement mode 1 (10Hz)
    ret = i2c_reg_write_byte(dev_i2c, 0x0c, 0x31, 0x02); // CNTL2 (MODE = 1)
    if (ret) {
        LOG_ERR("Error %d: Failed to set magnetometer to continuous measurement mode 1\n", ret);
        return -1;
    }

    // Wait for magnetometer to start up
    k_msleep(50);
    
    return 0;
}

// Thread for magnetometer reading. This could have been also
// implemented using a timer and a work queue.

// 500 byte stack area
K_THREAD_STACK_DEFINE(mag_thread_stack_area, 500);
struct k_thread mag_thread_data;

static void mag_thread_entry_point(void *p1, void *, void *) {
    // Get FIFO
    struct k_fifo *result_fifo = (struct k_fifo *)p1;

    while (1) {
        magneto_read(result_fifo);
        k_msleep(300);
    }
}

// magneto_start starts the magnetometer thread
void magneto_start(struct k_fifo *result_fifo) {
    k_tid_t mag_thread = k_thread_create(&mag_thread_data, mag_thread_stack_area,
        K_THREAD_STACK_SIZEOF(mag_thread_stack_area),
        mag_thread_entry_point,
        result_fifo, NULL, NULL, 0, 0, K_NO_WAIT);
    
    k_thread_name_set(mag_thread, "magneto");
}
```

## src/magneto.h
```c
#ifndef MAGNETO_H
#define MAGNETO_H

void magneto_init();
void magneto_start(struct k_fifo *result_fifo);

#endif // MAGNETO_H
```
